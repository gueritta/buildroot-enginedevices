## configs/jp11_defconfig
```kconfig
BR2_arm=y
BR2_cortex_a17=y
BR2_ARM_FPU_VFPV4=y
BR2_ARM_INSTRUCTIONS_THUMB2=y
BR2_KERNEL_HEADERS_VERSION=y
BR2_DEFAULT_KERNEL_VERSION="6.1.78"
BR2_BINUTILS_VERSION_2_39_X=y
BR2_GCC_VERSION_12_X=y
BR2_TOOLCHAIN_BUILDROOT_CXX=y
BR2_BACKUP_SITE="http://sources.buildroot.net"
BR2_CPAN_MIRROR="http://cpan.metacpan.org"
BR2_CCACHE=y
BR2_CCACHE_DIR="/home/kevin/.ccache"
BR2_GLOBAL_PATCH_DIR="$(BR2_EXTERNAL_MIXXX_PATH)/patches/"
# BR2_PIC_PIE is not set
BR2_SSP_NONE=y
BR2_RELRO_NONE=y
BR2_FORTIFY_SOURCE_NONE=y
BR2_INIT_SYSTEMD=y
BR2_TARGET_GENERIC_ROOT_PASSWD="denonprime4"
BR2_SYSTEM_DEFAULT_PATH="/bin:/sbin:/usr/bin:/usr/sbin"
BR2_LINUX_KERNEL=y
BR2_LINUX_KERNEL_CUSTOM_VERSION=y
BR2_LINUX_KERNEL_CUSTOM_VERSION_VALUE="6.1.78"
BR2_LINUX_KERNEL_PATCH="https://cdn.kernel.org/pub/linux/kernel/projects/rt/6.1/older/patches-6.1.77-rt24.tar.xz"
BR2_LINUX_KERNEL_USE_CUSTOM_CONFIG=y
BR2_LINUX_KERNEL_CUSTOM_CONFIG_FILE="$(BR2_EXTERNAL_MIXXX_PATH)/board/inmusic/common/linux.config"
BR2_PACKAGE_QT5=y
BR2_PACKAGE_QT5BASE_SQLITE_QT=y
BR2_PACKAGE_QT5BASE_DEFAULT_QPA="eglfs"
BR2_PACKAGE_MALI_T76X=y
BR2_PACKAGE_OPENSSH=y
# BR2_PACKAGE_OPENSSH_CLIENT is not set
BR2_ROOTFS_OVERLAY="$(BR2_EXTERNAL_MIXXX_PATH)/board/inmusic/jp11/rootfs_overlay"
BR2_ROOTFS_POST_BUILD_SCRIPT="$(BR2_EXTERNAL_MIXXX_PATH)/board/inmusic/jp11/post-build.sh"
BR2_PACKAGE_MIXXX=y
BR2_PACKAGE_MIXXX_SUPPORT_LOCALECOMPARE=y
# BR2_DOWNLOAD_FORCE_CHECK_HASHES is not set
```

## package/ms-gsl/Config.in
```kconfig
config BR2_PACKAGE_MS_GSL
	bool "ms-gsl"
	help
	  Microsoft Guidelines Support Library (GSL): functions and types
	  that are suggested for use by the C++ Core Guidelines.

	  https://github.com/microsoft/GSL
```
