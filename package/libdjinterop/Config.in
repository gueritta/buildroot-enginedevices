## package/libdjinterop/Config.in
```kconfig
config BR2_PACKAGE_LIBDJINTEROP
	bool "libdjinterop"
	depends on BR2_INSTALL_LIBSTDCPP # C++20
	depends on BR2_TOOLCHAIN_GCC_AT_LEAST_10 # C++20
	select BR2_PACKAGE_ZLIB
	select BR2_PACKAGE_SQLITE
	help
	  C++ library providing access to DJ record libraries.

	  https://github.com/xsco/libdjinterop

comment "libdjinterop needs a toolchain w/ C++, gcc >= 10"
	depends on !BR2_INSTALL_LIBSTDCPP || !BR2_TOOLCHAIN_GCC_AT_LEAST_10
```

## package/libebur128/Config.in
```kconfig
config BR2_PACKAGE_LIBEBUR128
	bool "libebur128"
	help
	  libebur128 is a library that implements the EBU R 128
	  standard for loudness normalization.

	  https://github.com/jiixyj/libebur128
```

## package/libkeyfinder/Config.in
```kconfig
config BR2_PACKAGE_LIBKEYFINDER
	bool "libkeyfinder"
	select BR2_PACKAGE_FFTW
	select BR2_PACKAGE_FFTW_DOUBLE
	help
	  Installs libkeyfinder, a small C++11 library for estimating
	  the musical key of digital audio.

	  https://mixxxdj.github.io/libkeyfinder/
```

## package/microsoft-gsl/Config.in
```kconfig
config BR2_PACKAGE_MICROSOFT_GSL
	bool "microsoft-gsl"
	help
	  The Guidelines Support Library (GSL) contains functions and
	  types that are suggested by the C++ Core Guidelines.

	  https://github.com/microsoft/GSL
```

## package/rubberband/Config.in
```kconfig
config BR2_PACKAGE_RUBBERBAND
	bool "rubberband"
	select BR2_PACKAGE_FFTW
	help
	  Installs rubberband, an audio time-stretching and
	  pitch-shifting library and utility program.

	  https://breakfastquay.com/rubberband/
```

## package/sord/Config.in
```kconfig
config BR2_PACKAGE_SORD
	bool "sord"
	help
	  Installs sord, a lightweight C library for storing RDF
	  statements in memory.

	  https://drobilla.net/software/sord.html
```
